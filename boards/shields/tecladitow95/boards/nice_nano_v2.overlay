#include "nice_nano_v2-pinctrl.dtsi"

&i2c0 {
    compatible = "nordic,nrf-twi";
    status = "okay";
    pinctrl-0 = <&i2c0_default>;
    pinctrl-1 = <&i2c0_sleep>;
    pinctrl-names = "default", "sleep";
    wakeup-source;
    clock-frequency = <I2C_BITRATE_STANDARD>;
};
