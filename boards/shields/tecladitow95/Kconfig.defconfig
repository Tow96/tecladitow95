## boards/shields/tecladitow95/Kconfig.defconfig
```kconfig
if SHIELD_TECLADITOW95

config ZMK_TECLADITOW95
    bool
    default y

config I2C
    bool
    default y

endif
```

## boards/shields/tecladitow95/Kconfig.shield
```kconfig
config SHIELD_TECLADITOW95
    def_bool $(shields_list_contains,tecladitow95)

config ZMK_KSCAN_MATRIX_POLLING
    bool
    default y

config GPIO_MCP230XX
    bool
    default y
```
